/**
 * @file uart_manager.cpp
 * @brief UART Manager implementation for ESP32 telematics system
 *
 * Generated by SmartWheels GenX
 */

#include "uart_manager.h"
#include "mqtt_manager.h"
#include "../config/system_config.h"
#include <stdarg.h>

UARTManager uartManager;

void UARTManager::init() {
    loggerInitialized = false;
    dataInitialized   = false;
    loggerSerial      = nullptr;
    dataSerial        = nullptr;

    #if UART_LOGGER_RUNTIME_CONTROL
    loggerEnabled = true;
    #endif

    dataLineBufferIndex = 0;
    memset(dataLineBuffer, 0, UART_DATA_LINE_BUFFER_SIZE);

    #if ENABLE_SERIAL_DEBUG
    Serial.println("[UART Manager] Initializing...");
    #endif

    initLoggerChannel();
    initDataChannel();

    #if ENABLE_SERIAL_DEBUG
    Serial.println("[UART Manager] Initialization complete");
    #endif
}

void UARTManager::update() {
    if (dataInitialized) {
        processDataChannel();
    }
}

// ============================================================================
// Logger Channel (UART0 / USB CDC)
// ============================================================================

void UARTManager::initLoggerChannel() {
    loggerSerial = &Serial;
    if (!Serial) {
        Serial.begin(UART_LOGGER_BAUD);
        delay(100);
    }
    loggerInitialized = true;

    #if ENABLE_SERIAL_DEBUG
    Serial.println("[UART Manager] Logger channel (UART0) initialized");
    Serial.printf("[UART Manager] Logger BAUD: %d\n", UART_LOGGER_BAUD);
    #endif
}

void UARTManager::initDataChannel() {
    dataSerial = new HardwareSerial(UART_DATA_NUM);

    #if ENABLE_SERIAL_DEBUG
    Serial.printf("[UART Manager] Initializing UART%d...\n", UART_DATA_NUM);
    Serial.printf("[UART Manager] RX: GPIO%d, TX: GPIO%d, BAUD: %d\n",
                  UART_DATA_RX_PIN, UART_DATA_TX_PIN, UART_DATA_BAUD);
    #endif

    dataSerial->begin(UART_DATA_BAUD, SERIAL_8N1, UART_DATA_RX_PIN, UART_DATA_TX_PIN);
    dataSerial->setTimeout(UART_READ_TIMEOUT_MS);
    delay(100);
    dataInitialized = true;

    #if ENABLE_SERIAL_DEBUG
    Serial.println("[UART Manager] Data channel (UART1) initialized successfully");
    #endif
}

void UARTManager::loggerWrite(const char* message) {
    #if UART_LOGGER_RUNTIME_CONTROL
    if (!loggerEnabled) return;
    #endif
    if (loggerInitialized && loggerSerial) {
        loggerSerial->print(message);
    }
}

void UARTManager::loggerPrintf(const char* format, ...) {
    #if UART_LOGGER_RUNTIME_CONTROL
    if (!loggerEnabled) return;
    #endif
    if (!loggerInitialized || !loggerSerial) return;

    char buffer[256];
    va_list args;
    va_start(args, format);
    vsnprintf(buffer, sizeof(buffer), format, args);
    va_end(args);
    loggerSerial->print(buffer);
}

void UARTManager::loggerWriteLine(const char* message) {
    #if UART_LOGGER_RUNTIME_CONTROL
    if (!loggerEnabled) return;
    #endif
    if (loggerInitialized && loggerSerial) {
        loggerSerial->println(message);
    }
}

int UARTManager::loggerAvailable() {
    return (loggerInitialized && loggerSerial) ? loggerSerial->available() : 0;
}

int UARTManager::loggerRead() {
    return (loggerInitialized && loggerSerial) ? loggerSerial->read() : -1;
}

size_t UARTManager::loggerReadBytes(char* buffer, size_t length) {
    return (loggerInitialized && loggerSerial) ? loggerSerial->readBytes(buffer, length) : 0;
}

void UARTManager::setLoggerEnabled(bool enable) {
    #if UART_LOGGER_RUNTIME_CONTROL
    loggerEnabled = enable;
    #if ENABLE_SERIAL_DEBUG
    Serial.printf("[UART Manager] Logger %s\n", enable ? "ENABLED" : "DISABLED");
    #endif
    #endif
}

bool UARTManager::isLoggerEnabled() {
    #if UART_LOGGER_RUNTIME_CONTROL
    return loggerEnabled;
    #else
    return UART_LOGGER_ENABLED;
    #endif
}

// ============================================================================
// Data Channel (UART1)
// ============================================================================

int UARTManager::dataAvailable() {
    return (dataInitialized && dataSerial) ? dataSerial->available() : 0;
}

int UARTManager::dataRead() {
    return (dataInitialized && dataSerial) ? dataSerial->read() : -1;
}

int UARTManager::dataWrite(const char* buffer, size_t length){
    return dataSerial->write(buffer,length);
}

size_t UARTManager::dataReadBytes(uint8_t* buffer, size_t length) {
    return (dataInitialized && dataSerial) ? dataSerial->readBytes(buffer, length) : 0;
}

bool UARTManager::isChannelInitialized(UARTChannel channel) {
    return (channel == UART_CHANNEL_LOGGER) ? loggerInitialized : dataInitialized;
}

// ============================================================================
// Data Channel Processing — parses SIGNAL_NAME,VALUE\n from MCU
// ============================================================================

void UARTManager::processDataChannel() {
    #if ENABLE_SERIAL_DEBUG
    static unsigned long lastDebugTime = 0;
    if (millis() - lastDebugTime >= 5000) {
        Serial.printf("[UART Debug] Data channel active, bytes available: %d\n",
                      dataSerial->available());
        lastDebugTime = millis();
    }
    #endif

    while (dataSerial->available() > 0) {
        char incomingByte = dataSerial->read();

        if (incomingByte == '\n') {
            if (dataLineBufferIndex > 0) {
                dataLineBuffer[dataLineBufferIndex] = '\0';
                parseCANDataLine(dataLineBuffer);
                dataLineBufferIndex = 0;
            }
        } else if (incomingByte == '\r') {
            // skip carriage return
        } else {
            if (dataLineBufferIndex < UART_DATA_LINE_BUFFER_SIZE - 1) {
                dataLineBuffer[dataLineBufferIndex++] = incomingByte;
            } else {
                #if ENABLE_SERIAL_DEBUG
                Serial.println("[UART Manager] ERROR: Data line buffer overflow!");
                #endif
                dataLineBufferIndex = 0;
            }
        }
    }
}

/**
 * Parse a complete line: SIGNAL_NAME,VALUE
 * VALUE may be decimal (255) or hexadecimal (0xFF / FF)
 */
void UARTManager::parseCANDataLine(const char* line) {
    const char* comma = strchr(line, ',');
    if (comma == nullptr) {
        #if ENABLE_SERIAL_DEBUG
        Serial.printf("[UART Manager] ERROR: Invalid format (no comma): %s\n", line);
        #endif
        return;
    }

    int nameLen = comma - line;
    if (nameLen <= 0 || nameLen >= 64) {
        #if ENABLE_SERIAL_DEBUG
        Serial.printf("[UART Manager] ERROR: Invalid signal name length: %s\n", line);
        #endif
        return;
    }

    char signalName[64];
    strncpy(signalName, line, nameLen);
    signalName[nameLen] = '\0';

    const char* dataStr = comma + 1;
    long dataValue;

    if (dataStr[0] == '0' && (dataStr[1] == 'x' || dataStr[1] == 'X')) {
        dataValue = strtol(dataStr, nullptr, 16);
    } else if (strchr(dataStr, 'x') != nullptr || strchr(dataStr, 'X') != nullptr) {
        dataValue = strtol(dataStr, nullptr, 16);
    } else {
        dataValue = strtol(dataStr, nullptr, 10);
    }

    #if ENABLE_SERIAL_DEBUG
    Serial.printf("[UART Data] %s = %ld (0x%lX)\n", signalName, dataValue, dataValue);
    #endif

    mqttManager.publishCANSignal(signalName, dataValue);
}
